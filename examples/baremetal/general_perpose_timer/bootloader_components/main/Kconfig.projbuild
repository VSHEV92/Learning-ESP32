## examples/baremetal/general_perpose_timer/bootloader_components/main/Kconfig.projbuild
```kconfig
menu "Baremetal General Perpose Timer"

    choice GENERAL_PERPOSE_TIMER_API
        prompt "GENERAL_PERPOSE_TIMER API"
        default GENERAL_PERPOSE_TIMER_LL_API
        help
            Select API used for perpose timer example.

        config GENERAL_PERPOSE_TIMER_HAL_API
            bool "General perpose timer HAL API"
        config GENERAL_PERPOSE_TIMER_LL_API
            bool "General perpose timer LL API"
    endchoice

    config GENERAL_PERPOSE_TIMER_PERIOD_MS
        int "General perpose timer period in miliseconds"
        default 1000
        help
            General perpose timer period in miliseconds.

endmenu
```

## examples/baremetal/system_timer/bootloader_components/main/Kconfig.projbuild
```kconfig
menu "Baremetal System Timer"

    choice SYSTEM_TIMER_API
        prompt "SYSTEM_TIMER API"
        default SYSTEM_TIMER_LL_API
        help
            Select API used for system timer example.

        config SYSTEM_TIMER_HAL_API
            bool "Syetem timer HAL API"
        config SYSTEM_TIMER_LL_API
            bool "Syetem timer LL API"
    endchoice

    config SYSTEM_TIMER_PERIOD_MS
        int "System timer period in miliseconds"
        default 1000
        help
            System timer period in miliseconds.

endmenu
```

## examples/esp32c3_baremetal/interrupts_system_timer/bootloader_components/main/Kconfig.projbuild
```kconfig
menu "Baremetal Interrrupts with System Timer"

    config SYSTEM_TIMER_PERIOD_MS
        int "System timer period in miliseconds"
        default 1000
        help
            System timer period in miliseconds.

endmenu
```

## examples/esp32c3_baremetal/led_blink/bootloader_components/main/Kconfig.projbuild
```kconfig
menu "Baremetal LED Blink"

    config LED_GPIO
        int "Led GPIO number"
        default 21
        help
            Led GPIO number.

    config BLINK_PERIOD_US
        int "Blink period in microseconds"
        default 1000000
        help
            Blink period in microseconds.

endmenu
```

## examples/esp32c3_baremetal/main_watchdog_timer/bootloader_components/main/Kconfig.projbuild
```kconfig
menu "Baremetal Main Watchdog Timer"

    choice MAIN_WATCHDOG_TIMER_API
        prompt "MAIN_WATCHDOG_TIMER API"
        default MAIN_WATCHDOG_TIMER_LL_API
        help
            Select API used for main_watchdog timer example.

        config MAIN_WATCHDOG_TIMER_HAL_API
            bool "Main Watchdog timer HAL API"
        config MAIN_WATCHDOG_TIMER_LL_API
            bool "Main Watchdog timer LL API"
    endchoice

endmenu
```

## examples/esp32c3_baremetal/spi_max7219/bootloader_components/main/Kconfig.projbuild
```kconfig
menu "Led Matrix with MAX7219 Example"

    orsource "$IDF_PATH/examples/common_components/env_caps/$IDF_TARGET/Kconfig.env_caps"

    config MAX7219_CLK_GPIO
        int "SPI CLK signal GPIO number"
        default 8
        help
            GPIO number of SPI CLK signal.

    config MAX7219_MOSI_GPIO
        int "SPI MOSI signal GPIO number"
        default 10
        help
            GPIO number of SPI MOSI signal.

    config MAX7219_CS_GPIO
        int "SPI CS signal GPIO number"
        default 21
        help
            GPIO number of SPI CS signal.

endmenu
```

## examples/led_and_button/main/Kconfig.projbuild
```kconfig
menu "Led and Button Example"

    orsource "$IDF_PATH/examples/common_components/env_caps/$IDF_TARGET/Kconfig.env_caps"

    choice GPIO_API
        prompt "GPIO API"
        default GPIO_DRIVER_API
        help
            Select API used to read button value and drive led.

        config GPIO_DRIVER_API
            bool "GPIO Driver API"
        config GPIO_HAL_API
            bool "GPIO HAL API"
        config GPIO_LL_API
            bool "GPIO Low Level API"
        config GPIO_SOC_API
            bool "GPIO Soc Macro API"
    endchoice

    config BUTTON_GPIO
        int "Button GPIO number"
        range ENV_GPIO_RANGE_MIN ENV_GPIO_OUT_RANGE_MAX
        default 0
        help
            GPIO number of button.

    config LED_GPIO
        int "Led GPIO number"
        range ENV_GPIO_RANGE_MIN ENV_GPIO_OUT_RANGE_MAX
        default 8
        help
            GPIO number of led.

endmenu
```

## examples/led_matrix_max7219/main/Kconfig.projbuild
```kconfig
menu "Led Matrix with MAX7219 Example"

    orsource "$IDF_PATH/examples/common_components/env_caps/$IDF_TARGET/Kconfig.env_caps"

    config CLK_GPIO
        int "SPI CLK signal GPIO number"
        range ENV_GPIO_RANGE_MIN ENV_GPIO_OUT_RANGE_MAX
        default 8
        help
            GPIO number of SPI CLK signal.

    config MOSI_GPIO
        int "SPI MOSI signal GPIO number"
        range ENV_GPIO_RANGE_MIN ENV_GPIO_OUT_RANGE_MAX
        default 10
        help
            GPIO number of SPI MOSI signal.

    config CS_GPIO
        int "SPI CS signal GPIO number"
        range ENV_GPIO_RANGE_MIN ENV_GPIO_OUT_RANGE_MAX
        default 21
        help
            GPIO number of SPI CS signal.

endmenu
```

## examples/nimble/ess_server/sdkconfig.defaults
```kconfig
CONFIG_IDF_TARGET="esp32c3"
CONFIG_BT_ENABLED=y
CONFIG_BT_NIMBLE_ENABLED=y
CONFIG_ESP_PHY_CALIBRATION_AND_DATA_STORAGE=n
```

## examples/nimble/rgb_led_client/sdkconfig.defaults
```kconfig
CONFIG_BT_ENABLED=y
CONFIG_BT_NIMBLE_ENABLED=y
CONFIG_ESP_PHY_CALIBRATION_AND_DATA_STORAGE=n
```
